## drivers/net/dpdk/Kconfig
```kconfig
#
# Data Plane Development Kit
#

comment "Data Plane Development Kit (DPDK) drivers"
	depends on DPDK

menuconfig DPDK
	bool "Data Plane Development Kit"
	depends on NET && PCI
	default n
	---help---
	  DPDK is a set of libraries and drivers for fast packet processing.
	  It was designed to run on any processors knowing Intel x86 has been
	  the first CPU to be supported.

	  http://dpdk.org

if DPDK

config DPDK_IGB_UIO
	tristate "UIO driver for Intel IGB PCI cards"
	depends on UIO = m && m
	default n
	---help---
	  To run any DPDK application, a suitable uio module can be loaded into
	  the running kernel. In many cases, the standard uio_pci_generic module
	  included in the linux kernel can provide the uio capability.

	  As an alternative to the uio_pci_generic, the DPDK also includes the
	  "igb_uio" module.

	  If you compile this as module, it will be called igb_uio.

	  Note:
	  For some devices which lack support for legacy interrupts,
	  e.g. virtual function (VF) devices, the igb_uio module may be needed
	  in place of uio_pci_generic.

	  Since DPDK release 1.7 onward provides VFIO support,
	  use of UIO is optional for platforms that support using VFIO.


source "drivers/net/dpdk/kni/Kconfig"

endif # DPDK
```

## drivers/net/dpdk/kni/Kconfig
```kconfig
#
# DPDK Kernel NIC Interface
#

config  DPDK_CACHE_LINE_SIZE
	int "Machine's cache line size"
	default 64

config  DPDK_KNI
	tristate "Kernel Module for managing kni devices"
	depends on m
	---help---
	  The Kernel NIC Interface (KNI) is a DPDK control plane solution that
	  allows userspace applications to exchange packets with the kernel
	  networking stack.

	  http://dpdk.org/doc/guides/sample_app_ug/kernel_nic_interface.html

config  DPDK_KNI_PREEMPT_DEFAULT
	bool "Preempt KNI by default"
	depends on DPDK_KNI
	default y

config  DPDK_KNI_KO_DEBUG
	bool "Show KNI debug messages"
	depends on DPDK_KNI
	default n

config  DPDK_KNI_VHOST
	bool "Enable KNI working as a kernel vHost backend"
	depends on DPDK_KNI
	default n
	---help---
	  vHost is a kernel module usually working as the backend of virtio
	  (a para- virtualization driver framework) to accelerate the traffic
	  from the guest to the host.

	  In the scenario where DPDK is running as fast path in the host,
	  kni-vhost is an efficient path for the traffic.

config  DPDK_KNI_VHOST_MAX_CACHE_SIZE
	int "vHost max chache size"
	depends on DPDK_KNI_VHOST
	default 1024

config  DPDK_KNI_VHOST_VNET_HDR_EN
	bool "Enable vHost HDR (GSO)"
	depends on DPDK_KNI_VHOST
	default n
	---help---
	  Enables KVM virtio_net driver to allow guest to apass larger (GSO)
	  packages.

config  DPDK_KNI_VHOST_DEBUG_RX
	bool "Rx vHost debug"
	depends on DPDK_KNI_VHOST
	default n

config  DPDK_KNI_VHOST_DEBUG_TX
	bool "Tx vHost debug"
	depends on DPDK_KNI_VHOST
	default n
```
